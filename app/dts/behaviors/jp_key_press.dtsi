/*
 * Copyright (c) 2020 The ZMK Contributors
 *
 * SPDX-License-Identifier: MIT
 */

#include <dt-bindings/zmk/behaviors.h>
#include <dt-bindings/zmk/keys.h>g

/ {
    behaviors {
         /omit-if-no-ref/ jkp: jp_key_press {
            compatible = "zmk,behavior-jp-key-press";
            #binding-cells = <1>;
            display-name = "JP Key Press";
        };
    };
};
#